## sdkconfig.defaults
```kconfig
# Hardware Settings
CONFIG_ESP_SLEEP_GPIO_RESET_WORKAROUND=y
CONFIG_RTC_CLK_SRC_INT_RC32K=y

# ESP - extra??
CONFIG_ESP_SLEEP_POWER_DOWN_FLASH=y
CONFIG_ESP_WIFI_NVS_ENABLED=n
CONFIG_GPIO_ESP32_SUPPORT_SWITCH_SLP_PULL=y

# Power Management
CONFIG_PM_ENABLE=y
CONFIG_PM_DFS_INIT_AUTO=y
CONFIG_PM_SLP_IRAM_OPT=y
CONFIG_PM_RTOS_IDLE_OPT=y
CONFIG_PM_SLP_DISABLE_GPIO=y
CONFIG_PM_POWER_DOWN_CPU_IN_LIGHT_SLEEP=y
CONFIG_PM_POWER_DOWN_PERIPHERAL_IN_LIGHT_SLEEP=y

# FreeRTOS
CONFIG_FREERTOS_HZ=1000
CONFIG_FREERTOS_USE_TICKLESS_IDLE=y
CONFIG_FREERTOS_IDLE_TIME_BEFORE_SLEEP=3

# PHY
CONFIG_ESP_PHY_MAC_BB_PD=y

# Wi-Fi
CONFIG_ESP_WIFI_SLP_IRAM_OPT=y
CONFIG_ESP_WIFI_SLP_DEFAULT_MIN_ACTIVE_TIME=10
CONFIG_ESP_WIFI_SLP_DEFAULT_MAX_ACTIVE_TIME=60
CONFIG_ESP_WIFI_ENHANCED_LIGHT_SLEEP=y
CONFIG_ESP_WIFI_SLP_BEACON_LOST_OPT=y
CONFIG_ESP_WIFI_SLP_BEACON_LOST_TIMEOUT=10
CONFIG_ESP_WIFI_SLP_BEACON_LOST_THRESHOLD=3

# LWIP
CONFIG_LWIP_ESP_GRATUITOUS_ARP=n
CONFIG_LWIP_DHCP_COARSE_TIMER_SECS=10

# disable ANSI chars in log messages
CONFIG_LOG_COLORS=n
```
